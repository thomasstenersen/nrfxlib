## ble_controller/Kconfig
```kconfig
#
# Copyright (c) 2018 Nordic Semiconductor
#
# SPDX-License-Identifier: LicenseRef-BSD-5-Clause-Nordic
#

# BT_LL_CHOICE is declared in Zephyr and also here for a second time,
# now with additional properties. Note that the dependencies of the
# original config must be duplicated to not affect it's visibility.
choice BT_LL_CHOICE
	bool
	depends on (BT_CTLR && BT_HCI && BT)

config BT_LL_NRFXLIB
	bool "Nordic proprietary BLE Link Layer"
	select ZERO_LATENCY_IRQS
	select ENTROPY_NRF5_RNG
	help
	  Use Nordic BLE Link Layer implementation.

endchoice

choice CLOCK_CONTROL_NRF5_IMPL
	bool
	prompt "nRF5 Clock controller implementation"
	default CLOCK_CONTROL_NRF5_NRFXLIB if BT_LL_NRFXLIB

config CLOCK_CONTROL_NRF5_NRFXLIB
	bool "nRF5 Clock controller from nrfxlib"
	depends on BT_LL_NRFXLIB
	help
	  Use Nordic BLE Link Layer implementation.

endchoice

choice CLOCK_CONTROL_NR5_SOURCE
	prompt "32KHz clock source"

config CLOCK_CONTROL_NRF5_K32SRC_SYNTH
	bool "Synthesized from HFCLK"

endchoice

choice CLOCK_CONTROL_NR5_ACCURACY
	prompt "32KHz clock accuracy"

config CLOCK_CONTROL_NRF5_K32SRC_10PPM
	bool "6 ppm to 10 ppm"

config CLOCK_CONTROL_NRF5_K32SRC_5PPM
	bool "3 ppm to 5 ppm"

config CLOCK_CONTROL_NRF5_K32SRC_2PPM
	bool "2 ppm"

config CLOCK_CONTROL_NRF5_K32SRC_1PPM
	bool "1 ppm"

endchoice #CLOCK_CONTROL_NR5_ACCURACY

if ENTROPY_NRF5_RNG

choice ENTROPY_NRF5_RNG_IMPL
	bool "nRF5 RNG driver implementation"
	default ENTROPY_NRF5_RNG_NRFXLIB if BT_LL_NRFXLIB
	help
	  Choose the driver implementation

# Selection of ENTROPY_HAS_DRIVER is removed to prevent compilation
# fail because of no source is provided to library
config ENTROPY_NRF5_RNG_NRFXLIB
	bool "nRF5 RNG driver from nrfxlib"
	depends on BT_LL_NRFXLIB
	help
	  This option enables the RNG peripheral, which is a random number
	  generator, based on internal thermal noise, that provides a
	  random 8-bit value to the host when read.

endchoice

endif #ENTROPY_NRF5_RNG

if BT_LL_NRFXLIB

comment "Common BLE Controller module configuration"

choice BLE_CONTROLLER_VARIANT
	prompt "BLE Controller variant"
	default BLE_CONTROLLER_S112 if SOC_NRF52810
	default BLE_CONTROLLER_S132 if SOC_NRF52832
	default BLE_CONTROLLER_S140 if SOC_NRF52840
	help
		Select a BLE Controller variant.

config BLE_CONTROLLER_S112
	depends on (SOC_NRF52810 || SOC_NRF52832)
	bool "s112"

config BLE_CONTROLLER_S132
	depends on (SOC_NRF52810 || SOC_NRF52832)
	bool "s132"

config BLE_CONTROLLER_S140
	depends on SOC_NRF52840
	bool "s140"

endchoice

endif # BT_LL_NRFXLIB
```
